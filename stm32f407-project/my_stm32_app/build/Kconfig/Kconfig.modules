## stm32f407-project/my_stm32_app/build/Kconfig/soc/Kconfig
```kconfig
# Load Zephyr SoC Kconfig descriptions.
osource "/workspaces/stm32f407_syncforge_zephyr/stm32f407-project/zephyr/soc/xlnx/zynqmp/Kconfig"
osource "/workspaces/stm32f407_syncforge_zephyr/stm32f407-project/zephyr/soc/xlnx/zynq7000/Kconfig"
osource "/workspaces/stm32f407_syncforge_zephyr/stm32f407-project/zephyr/soc/xlnx/versalnet/Kconfig"
osource "/workspaces/stm32f407_syncforge_zephyr/stm32f407-project/zephyr/soc/xen/Kconfig"
osource "/workspaces/stm32f407_syncforge_zephyr/stm32f407-project/zephyr/soc/wch/ch32v/Kconfig"
osource "/workspaces/stm32f407_syncforge_zephyr/stm32f407-project/zephyr/soc/ti/simplelink/Kconfig"
osource "/workspaces/stm32f407_syncforge_zephyr/stm32f407-project/zephyr/soc/ti/lm3s6965/Kconfig"
osource "/workspaces/stm32f407_syncforge_zephyr/stm32f407-project/zephyr/soc/ti/k3/Kconfig"
osource "/workspaces/stm32f407_syncforge_zephyr/stm32f407-project/zephyr/soc/telink/tlsr/Kconfig"
osource "/workspaces/stm32f407_syncforge_zephyr/stm32f407-project/zephyr/soc/starfive/jh71xx/Kconfig"
osource "/workspaces/stm32f407_syncforge_zephyr/stm32f407-project/zephyr/soc/st/stm32/Kconfig"
osource "/workspaces/stm32f407_syncforge_zephyr/stm32f407-project/zephyr/soc/snps/qemu_arc/Kconfig"
osource "/workspaces/stm32f407_syncforge_zephyr/stm32f407-project/zephyr/soc/snps/nsim/arc_v/Kconfig"
osource "/workspaces/stm32f407_syncforge_zephyr/stm32f407-project/zephyr/soc/snps/nsim/arc_classic/Kconfig"
osource "/workspaces/stm32f407_syncforge_zephyr/stm32f407-project/zephyr/soc/snps/hsdk4xd/Kconfig"
osource "/workspaces/stm32f407_syncforge_zephyr/stm32f407-project/zephyr/soc/snps/hsdk/Kconfig"
osource "/workspaces/stm32f407_syncforge_zephyr/stm32f407-project/zephyr/soc/snps/emsk/Kconfig"
osource "/workspaces/stm32f407_syncforge_zephyr/stm32f407-project/zephyr/soc/snps/emsdp/Kconfig"
osource "/workspaces/stm32f407_syncforge_zephyr/stm32f407-project/zephyr/soc/snps/arc_iot/Kconfig"
osource "/workspaces/stm32f407_syncforge_zephyr/stm32f407-project/zephyr/soc/silabs/Kconfig"
osource "/workspaces/stm32f407_syncforge_zephyr/stm32f407-project/zephyr/soc/sifive/sifive_freedom/Kconfig"
osource "/workspaces/stm32f407_syncforge_zephyr/stm32f407-project/zephyr/soc/sensry/Kconfig"
osource "/workspaces/stm32f407_syncforge_zephyr/stm32f407-project/zephyr/soc/rockchip/Kconfig"
osource "/workspaces/stm32f407_syncforge_zephyr/stm32f407-project/zephyr/soc/renode/riscv_virtual/Kconfig"
osource "/workspaces/stm32f407_syncforge_zephyr/stm32f407-project/zephyr/soc/renode/cortex_r8_virtual/Kconfig"
osource "/workspaces/stm32f407_syncforge_zephyr/stm32f407-project/zephyr/soc/renesas/smartbond/Kconfig"
osource "/workspaces/stm32f407_syncforge_zephyr/stm32f407-project/zephyr/soc/renesas/rz/Kconfig"
osource "/workspaces/stm32f407_syncforge_zephyr/stm32f407-project/zephyr/soc/renesas/rcar/Kconfig"
osource "/workspaces/stm32f407_syncforge_zephyr/stm32f407-project/zephyr/soc/renesas/ra/Kconfig"
osource "/workspaces/stm32f407_syncforge_zephyr/stm32f407-project/zephyr/soc/realtek/ec/Kconfig"
osource "/workspaces/stm32f407_syncforge_zephyr/stm32f407-project/zephyr/soc/raspberrypi/rpi_pico/Kconfig"
osource "/workspaces/stm32f407_syncforge_zephyr/stm32f407-project/zephyr/soc/quicklogic/eos_s3/Kconfig"
osource "/workspaces/stm32f407_syncforge_zephyr/stm32f407-project/zephyr/soc/qemu/virt_riscv/Kconfig"
osource "/workspaces/stm32f407_syncforge_zephyr/stm32f407-project/zephyr/soc/qemu/malta/Kconfig"
osource "/workspaces/stm32f407_syncforge_zephyr/stm32f407-project/zephyr/soc/openisa/rv32m1/Kconfig"
osource "/workspaces/stm32f407_syncforge_zephyr/stm32f407-project/zephyr/soc/openhwgroup/cva6/Kconfig"
osource "/workspaces/stm32f407_syncforge_zephyr/stm32f407-project/zephyr/soc/oct/osd32mp15x/Kconfig"
osource "/workspaces/stm32f407_syncforge_zephyr/stm32f407-project/zephyr/soc/nxp/s32/Kconfig"
osource "/workspaces/stm32f407_syncforge_zephyr/stm32f407-project/zephyr/soc/nxp/rw/Kconfig"
osource "/workspaces/stm32f407_syncforge_zephyr/stm32f407-project/zephyr/soc/nxp/mcx/Kconfig"
osource "/workspaces/stm32f407_syncforge_zephyr/stm32f407-project/zephyr/soc/nxp/lpc/Kconfig"
osource "/workspaces/stm32f407_syncforge_zephyr/stm32f407-project/zephyr/soc/nxp/layerscape/Kconfig"
osource "/workspaces/stm32f407_syncforge_zephyr/stm32f407-project/zephyr/soc/nxp/kinetis/Kconfig"
osource "/workspaces/stm32f407_syncforge_zephyr/stm32f407-project/zephyr/soc/nxp/imxrt/Kconfig"
osource "/workspaces/stm32f407_syncforge_zephyr/stm32f407-project/zephyr/soc/nxp/imx/Kconfig"
osource "/workspaces/stm32f407_syncforge_zephyr/stm32f407-project/zephyr/soc/nuvoton/numicro/Kconfig"
osource "/workspaces/stm32f407_syncforge_zephyr/stm32f407-project/zephyr/soc/nuvoton/numaker/Kconfig"
osource "/workspaces/stm32f407_syncforge_zephyr/stm32f407-project/zephyr/soc/nuvoton/npcx/Kconfig"
osource "/workspaces/stm32f407_syncforge_zephyr/stm32f407-project/zephyr/soc/nuvoton/npcm/Kconfig"
osource "/workspaces/stm32f407_syncforge_zephyr/stm32f407-project/zephyr/soc/nordic/Kconfig"
osource "/workspaces/stm32f407_syncforge_zephyr/stm32f407-project/zephyr/soc/neorv32/Kconfig"
osource "/workspaces/stm32f407_syncforge_zephyr/stm32f407-project/zephyr/soc/native/inf_clock/Kconfig"
osource "/workspaces/stm32f407_syncforge_zephyr/stm32f407-project/zephyr/soc/microchip/miv/Kconfig"
osource "/workspaces/stm32f407_syncforge_zephyr/stm32f407-project/zephyr/soc/microchip/mec/Kconfig"
osource "/workspaces/stm32f407_syncforge_zephyr/stm32f407-project/zephyr/soc/mediatek/mt8xxx/Kconfig"
osource "/workspaces/stm32f407_syncforge_zephyr/stm32f407-project/zephyr/soc/lowrisc/opentitan/Kconfig"
osource "/workspaces/stm32f407_syncforge_zephyr/stm32f407-project/zephyr/soc/litex/litex_vexriscv/Kconfig"
osource "/workspaces/stm32f407_syncforge_zephyr/stm32f407-project/zephyr/soc/ite/ec/Kconfig"
osource "/workspaces/stm32f407_syncforge_zephyr/stm32f407-project/zephyr/soc/intel/raptor_lake/Kconfig"
osource "/workspaces/stm32f407_syncforge_zephyr/stm32f407-project/zephyr/soc/intel/lakemont/Kconfig"
osource "/workspaces/stm32f407_syncforge_zephyr/stm32f407-project/zephyr/soc/intel/intel_socfpga_std/Kconfig"
osource "/workspaces/stm32f407_syncforge_zephyr/stm32f407-project/zephyr/soc/intel/intel_socfpga/Kconfig"
osource "/workspaces/stm32f407_syncforge_zephyr/stm32f407-project/zephyr/soc/intel/intel_niosv/Kconfig"
osource "/workspaces/stm32f407_syncforge_zephyr/stm32f407-project/zephyr/soc/intel/intel_ish/Kconfig"
osource "/workspaces/stm32f407_syncforge_zephyr/stm32f407-project/zephyr/soc/intel/intel_adsp/Kconfig"
osource "/workspaces/stm32f407_syncforge_zephyr/stm32f407-project/zephyr/soc/intel/elkhart_lake/Kconfig"
osource "/workspaces/stm32f407_syncforge_zephyr/stm32f407-project/zephyr/soc/intel/atom/Kconfig"
osource "/workspaces/stm32f407_syncforge_zephyr/stm32f407-project/zephyr/soc/intel/apollo_lake/Kconfig"
osource "/workspaces/stm32f407_syncforge_zephyr/stm32f407-project/zephyr/soc/intel/alder_lake/Kconfig"
osource "/workspaces/stm32f407_syncforge_zephyr/stm32f407-project/zephyr/soc/infineon/cat3/Kconfig"
osource "/workspaces/stm32f407_syncforge_zephyr/stm32f407-project/zephyr/soc/infineon/cat1b/Kconfig"
osource "/workspaces/stm32f407_syncforge_zephyr/stm32f407-project/zephyr/soc/infineon/cat1a/Kconfig"
osource "/workspaces/stm32f407_syncforge_zephyr/stm32f407-project/zephyr/soc/gd/gd32/Kconfig"
osource "/workspaces/stm32f407_syncforge_zephyr/stm32f407-project/zephyr/soc/gaisler/leon3/Kconfig"
osource "/workspaces/stm32f407_syncforge_zephyr/stm32f407-project/zephyr/soc/gaisler/gr716a/Kconfig"
osource "/workspaces/stm32f407_syncforge_zephyr/stm32f407-project/zephyr/soc/espressif/Kconfig"
osource "/workspaces/stm32f407_syncforge_zephyr/stm32f407-project/zephyr/soc/ene/kb1200/Kconfig"
osource "/workspaces/stm32f407_syncforge_zephyr/stm32f407-project/zephyr/soc/efinix/sapphire/Kconfig"
osource "/workspaces/stm32f407_syncforge_zephyr/stm32f407-project/zephyr/soc/cdns/xtensa_sample_controller/Kconfig"
osource "/workspaces/stm32f407_syncforge_zephyr/stm32f407-project/zephyr/soc/cdns/sample_controller32/Kconfig"
osource "/workspaces/stm32f407_syncforge_zephyr/stm32f407-project/zephyr/soc/cdns/dc233c/Kconfig"
osource "/workspaces/stm32f407_syncforge_zephyr/stm32f407-project/zephyr/soc/brcm/bcmvk/Kconfig"
osource "/workspaces/stm32f407_syncforge_zephyr/stm32f407-project/zephyr/soc/brcm/bcm2712/Kconfig"
osource "/workspaces/stm32f407_syncforge_zephyr/stm32f407-project/zephyr/soc/brcm/bcm2711/Kconfig"
osource "/workspaces/stm32f407_syncforge_zephyr/stm32f407-project/zephyr/soc/bflb/Kconfig"
osource "/workspaces/stm32f407_syncforge_zephyr/stm32f407-project/zephyr/soc/atmel/sam0/Kconfig"
osource "/workspaces/stm32f407_syncforge_zephyr/stm32f407-project/zephyr/soc/atmel/sam/Kconfig"
osource "/workspaces/stm32f407_syncforge_zephyr/stm32f407-project/zephyr/soc/aspeed/Kconfig"
osource "/workspaces/stm32f407_syncforge_zephyr/stm32f407-project/zephyr/soc/arm/Kconfig"
osource "/workspaces/stm32f407_syncforge_zephyr/stm32f407-project/zephyr/soc/arm/beetle/Kconfig"
osource "/workspaces/stm32f407_syncforge_zephyr/stm32f407-project/zephyr/soc/antmicro/myra/Kconfig"
osource "/workspaces/stm32f407_syncforge_zephyr/stm32f407-project/zephyr/soc/andestech/Kconfig"
osource "/workspaces/stm32f407_syncforge_zephyr/stm32f407-project/zephyr/soc/amd/acp_6_0/Kconfig"
osource "/workspaces/stm32f407_syncforge_zephyr/stm32f407-project/zephyr/soc/ambiq/Kconfig"
osource "/workspaces/stm32f407_syncforge_zephyr/stm32f407-project/zephyr/soc/altr/zephyr_nios2f/Kconfig"
osource "/workspaces/stm32f407_syncforge_zephyr/stm32f407-project/zephyr/soc/altr/qemu_nios2/Kconfig"
osource "/workspaces/stm32f407_syncforge_zephyr/stm32f407-project/zephyr/soc/adi/max32/Kconfig"
```
